VERSION ""

NS_ :

BS_:

BU_:

BO_ 2000 CABIN: 8 Vector__XXX
 SG_ DoorsState : 0|5@0+ (1,0) [0|31] "NOTDEF" Vector__XXX

BO_ 2001 ENV: 8 Vector__XXX
 SG_ AmbientAirTemperature : 0|8@0+ (0.5,-40) [-40|85] "C" Vector__XXX

BA_DEF_ BO_  "GenMsgCycleTime" INT 0 10000;
BA_DEF_DEF_  "GenMsgCycleTime" 0;

BA_ "GenMsgCycleTime" BO_ 2000 1000;
BA_ "GenMsgCycleTime" BO_ 2001 1000;
